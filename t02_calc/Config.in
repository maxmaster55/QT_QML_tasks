## t02_calc/Config.in
```kconfig
config BR2_PACKAGE_QT_CALCULATOR
    bool "qt_calculator"
    depends on BR2_PACKAGE_QT6BASE
    help
      Calculator Qt6 QML application.
```

## t04_ledController/Config.in
```kconfig
config BR2_PACKAGE_QT_LED_CONTROLLER
    bool "qt_led_controller"
    depends on BR2_PACKAGE_QT6BASE
    help
      LED Controller Qt6 QML application.
```
